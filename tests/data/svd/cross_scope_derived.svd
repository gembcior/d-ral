# CrossScopeDerivedTest register map
Minimal device exercising cross-scope derivedFrom through the full dral pipeline
Registers are 32-bit, read-write, reset 0x0 unless marked. A register's access mark holds for its fields unless they carry their own. Offsets are from the block's base; lines under a group give offsets from that group; [hi:lo] are bit positions; {n}, {i} and the like mark numbered series; 'fields as' and 'values as' point back to an identical list; <NAME> marks a mode.

## Memory map
0x40000000 PeripheralA — Origin peripheral
0x40001000 PeripheralB — Peripheral with a register derived from a different peripheral's register

## PeripheralA — Origin peripheral
Base 0x40000000
0x00 RegX — Origin register
  [3:0] FieldX — Origin field

## PeripheralB — Peripheral with a register derived from a different peripheral's register
Base 0x40001000
0x04 RegY — Cross-scope derived register
  [3:0] FieldX — Origin field
